/*
  20.07.2013
  SerPanRC@yandex.ru
  http://forum.rcdesign.ru/f90/thread327590.html
  
  */
#include <SPI.h>
#include <EEPROM.h>

#define PIN_SCE 5 //  XCS 
#define PIN_SDIN 4 // SDA
#define PIN_RESET 6 // XRES
#define PIN_SCLK 3 // SCLK
#define Rssiin A6 // вход RSSI
#define Bolche A3
#define Regim A2
#define Menche A0
#define Vvod A1
#define SSP 10

#define LCD_C LOW // Command
#define LCD_D HIGH // Data

unsigned char lcd_x = 0, lcd_y = 0;
byte column=0; // cтолбец
byte line=0; // строка
byte contrast=1;
float t = 0;
static const byte LOGO[][96] ={
{0x00,0x00,0x00,0xC0,0x30,0x08,0x08,0x0C,0x04,0x04,0x04,0x04,0x0C,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0x00,0x00},

{0x00,0x00,0x00,0x0F,0x38,0x60,0xC0,0x80,0x00,0x00,0x00,0x00,0x00,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0x70,0x00},

{0x00,0x00,0x00,0x00,0x00,0x00,0x00,0x01,0x01,0x03,0x02,0x06,0x04,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0x00,0x00},

{0x00,0x00,0x00,0x1E,0x3C,0x20,0x20,0x40,0x40,0x40,0x40,0x40,0x20,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0x00,0x00}
};
static const byte ASCII[][5] ={
{0x00, 0x00, 0x00, 0x00, 0x00} // 20
,{0x00, 0x00, 0x5f, 0x00, 0x00} // 21 !
,{0x00, 0x07, 0x00, 0x07, 0x00} // 22 "
,{0x14, 0x7f, 0x14, 0x7f, 0x14} // 23 #
,{0x24, 0x2a, 0x7f, 0x2a, 0x12} // 24 $
,{0x23, 0x13, 0x08, 0x64, 0x62} // 25 %
,{0x36, 0x49, 0x55, 0x22, 0x50} // 26 &
,{0x00, 0x05, 0x03, 0x00, 0x00} // 27 '
,{0x00, 0x1c, 0x22, 0x41, 0x00} // 28 (
,{0x00, 0x41, 0x22, 0x1c, 0x00} // 29 )
,{0x14, 0x08, 0x3e, 0x08, 0x14} // 2a *
,{0x08, 0x08, 0x3e, 0x08, 0x08} // 2b +
,{0x00, 0x50, 0x30, 0x00, 0x00} // 2c ,
,{0x08, 0x08, 0x08, 0x08, 0x08} // 2d -
,{0x00, 0x60, 0x60, 0x00, 0x00} // 2e .
,{0x20, 0x10, 0x08, 0x04, 0x02} // 2f /
,{0x3e, 0x51, 0x49, 0x45, 0x3e} // 30 0
,{0x00, 0x42, 0x7f, 0x40, 0x00} // 31 1
,{0x42, 0x61, 0x51, 0x49, 0x46} // 32 2
,{0x21, 0x41, 0x45, 0x4b, 0x31} // 33 3
,{0x18, 0x14, 0x12, 0x7f, 0x10} // 34 4
,{0x27, 0x45, 0x45, 0x45, 0x39} // 35 5
,{0x3c, 0x4a, 0x49, 0x49, 0x30} // 36 6
,{0x01, 0x71, 0x09, 0x05, 0x03} // 37 7
,{0x36, 0x49, 0x49, 0x49, 0x36} // 38 8
,{0x06, 0x49, 0x49, 0x29, 0x1e} // 39 9
,{0x00, 0x36, 0x36, 0x00, 0x00} // 3a :
,{0x00, 0x56, 0x36, 0x00, 0x00} // 3b ;
,{0x08, 0x14, 0x22, 0x41, 0x00} // 3c <
,{0x14, 0x14, 0x14, 0x14, 0x14} // 3d =
,{0x00, 0x41, 0x22, 0x14, 0x08} // 3e >
,{0x02, 0x01, 0x51, 0x09, 0x06} // 3f ?
,{0x32, 0x49, 0x79, 0x41, 0x3e} // 40 @
,{0x7e, 0x11, 0x11, 0x11, 0x7e} // 41 A
,{0x7f, 0x49, 0x49, 0x49, 0x36} // 42 B
,{0x3e, 0x41, 0x41, 0x41, 0x22} // 43 C
,{0x7f, 0x41, 0x41, 0x22, 0x1c} // 44 D
,{0x7f, 0x49, 0x49, 0x49, 0x41} // 45 E
,{0x7f, 0x09, 0x09, 0x09, 0x01} // 46 F
,{0x3e, 0x41, 0x49, 0x49, 0x7a} // 47 G
,{0x7f, 0x08, 0x08, 0x08, 0x7f} // 48 H
,{0x00, 0x41, 0x7f, 0x41, 0x00} // 49 I
,{0x20, 0x40, 0x41, 0x3f, 0x01} // 4a J
,{0x7f, 0x08, 0x14, 0x22, 0x41} // 4b K
,{0x7f, 0x40, 0x40, 0x40, 0x40} // 4c L
,{0x7f, 0x02, 0x0c, 0x02, 0x7f} // 4d M
,{0x7f, 0x04, 0x08, 0x10, 0x7f} // 4e N
,{0x3e, 0x41, 0x41, 0x41, 0x3e} // 4f O
,{0x7f, 0x09, 0x09, 0x09, 0x06} // 50 P
,{0x3e, 0x41, 0x51, 0x21, 0x5e} // 51 Q
,{0x7f, 0x09, 0x19, 0x29, 0x46} // 52 R
,{0x46, 0x49, 0x49, 0x49, 0x31} // 53 S
,{0x01, 0x01, 0x7f, 0x01, 0x01} // 54 T
,{0x3f, 0x40, 0x40, 0x40, 0x3f} // 55 U
,{0x1f, 0x20, 0x40, 0x20, 0x1f} // 56 V
,{0x3f, 0x40, 0x38, 0x40, 0x3f} // 57 W
,{0x63, 0x14, 0x08, 0x14, 0x63} // 58 X
,{0x07, 0x08, 0x70, 0x08, 0x07} // 59 Y
,{0x61, 0x51, 0x49, 0x45, 0x43} // 5a Z
,{0x00, 0x7f, 0x41, 0x41, 0x00} // 5b [
,{0x02, 0x04, 0x08, 0x10, 0x20} // 5c ¥
,{0x00, 0x41, 0x41, 0x7f, 0x00} // 5d ]
,{0x04, 0x02, 0x01, 0x02, 0x04} // 5e ^
,{0x40, 0x40, 0x40, 0x40, 0x40} // 5f _
,{0x00, 0x01, 0x02, 0x04, 0x00} // 60 `
,{0x20, 0x54, 0x54, 0x54, 0x78} // 61 a
,{0x7f, 0x48, 0x44, 0x44, 0x38} // 62 b
,{0x38, 0x44, 0x44, 0x44, 0x20} // 63 c
,{0x38, 0x44, 0x44, 0x48, 0x7f} // 64 d
,{0x38, 0x54, 0x54, 0x54, 0x18} // 65 e
,{0x08, 0x7e, 0x09, 0x01, 0x02} // 66 f
,{0x0c, 0x52, 0x52, 0x52, 0x3e} // 67 g
,{0x7f, 0x08, 0x04, 0x04, 0x78} // 68 h
,{0x00, 0x44, 0x7d, 0x40, 0x00} // 69 i
,{0x20, 0x40, 0x44, 0x3d, 0x00} // 6a j
,{0x7f, 0x10, 0x28, 0x44, 0x00} // 6b k
,{0x00, 0x41, 0x7f, 0x40, 0x00} // 6c l
,{0x7c, 0x04, 0x18, 0x04, 0x78} // 6d m
,{0x7c, 0x08, 0x04, 0x04, 0x78} // 6e n
,{0x38, 0x44, 0x44, 0x44, 0x38} // 6f o
,{0x7c, 0x14, 0x14, 0x14, 0x08} // 70 p
,{0x08, 0x14, 0x14, 0x18, 0x7c} // 71 q
,{0x7c, 0x08, 0x04, 0x04, 0x08} // 72 r
,{0x48, 0x54, 0x54, 0x54, 0x20} // 73 s
,{0x04, 0x3f, 0x44, 0x40, 0x20} // 74 t
,{0x3c, 0x40, 0x40, 0x20, 0x7c} // 75 u
,{0x1c, 0x20, 0x40, 0x20, 0x1c} // 76 v
,{0x3c, 0x40, 0x30, 0x40, 0x3c} // 77 w
,{0x44, 0x28, 0x10, 0x28, 0x44} // 78 x
,{0x0c, 0x50, 0x50, 0x50, 0x3c} // 79 y
,{0x44, 0x64, 0x54, 0x4c, 0x44} // 7a z
,{0x00, 0x08, 0x36, 0x41, 0x00} // 7b {
,{0x00, 0x00, 0x7f, 0x00, 0x00} // 7c |
,{0x00, 0x41, 0x36, 0x08, 0x00} // 7d }
,{0x10, 0x08, 0x08, 0x10, 0x08} // 7e ←
,{0x78, 0x46, 0x41, 0x46, 0x78} // 7f →
};

byte j=0;

void LcdCharacter(char character){
  LcdWrite(LCD_D, 0x00);
  for (int index = 0; index < 5; index++)
  {LcdWrite(LCD_D, ASCII[character - 0x20][index]);
  }}
  
void LcdClear(void){
for (int index = 0; index < 864 ; index++)
LcdWrite(LCD_D, 0x00);
}
// Установить позицию на экране c x r в символах
void lcd_set_pos(unsigned char c, unsigned char r){
  c = c*6;
  r = r*1;
  lcd_set_pos_pix(c,r);
}

// Установить позицию на экране c x r в пикселях
void lcd_set_pos_pix(unsigned char c, unsigned char r){
  lcd_x = c;
  lcd_y = r;
  LcdWrite(LCD_C,0xB0 | (r & 0x0F));
  LcdWrite(LCD_C,0x10 | ((c >> 4) & 0x07));
  LcdWrite(LCD_C,0x00 | (c & 0x0F));
}

// Перенос строки
void lcd_crlf(void){
  lcd_x = 0;
  lcd_y = lcd_y+1;
  if(lcd_y>=8) lcd_y = 0;
  lcd_set_pos_pix(lcd_x,lcd_y);}
  
  void lcd_contrast(byte contrast)
{
    contrast = contrast & 0x1F;
    LcdWrite(LCD_C,0x80 + contrast); // контрастность (0-31)
  }
    
void Lcd_drawColumn(unsigned char sline, unsigned char value){//строк пустых наверху ,уровень что отражаем

    unsigned char lines=9-sline;
    if (value > lines*8) value = lines*8;
    unsigned char mark = (lines*8 - 1 - value)/8;
    for (unsigned char line = 0; line < mark; line++) { 
        lcd_set_pos_pix(column, sline + line);
        LcdWrite(LCD_D, 0x00);}
        
    unsigned char b = 0xff;
    for (unsigned char i = 0; i < lines*8 - mark*8 - value; i++) {
        b <<= 1;
    }
    lcd_set_pos_pix(column, sline + mark);
    LcdWrite(LCD_D, b);
    // Fill the lines below the mark...
    for (unsigned char line = mark + 1; line < lines; line++) {
        lcd_set_pos_pix(column, sline + line);
        LcdWrite(LCD_D, 0xff);
    } 
    //lcd_set_pos_pix(column +1, sline);
  }

void LcdInitialise(void){
//digitalWrite(PIN_RESET, LOW);
digitalWrite(PIN_RESET, HIGH);
LcdWrite(LCD_C, 0xE2); // сброс програмный
LcdWrite(LCD_C, 0x3D); // Charge pump ON
LcdWrite(LCD_C, 0x01); // Charge pump=4
LcdWrite(LCD_C, 0xA4); //
LcdWrite(LCD_C, 0x2F); //
//LcdWrite(LCD_C, 0xC8);// зеркально верх-низ
LcdWrite(LCD_C, 0xC0); //нормальное верх-низ
//LcdWrite(LCD_C, 0xA1);// зеркально лево-право
LcdWrite(LCD_C, 0xC0); //нормальное лево-право
LcdWrite(LCD_C, 0xAF); // Display ON
}

void LcdString(char *characters){
while (*characters){
LcdCharacter(*characters++);
}
}

void LcdString_f(unsigned int func){  // печатаем четырехзначное число
byte k = 0;
if (func>9999) func=9999;
unsigned int n=10000;
for ( byte i = 0; i < 4; i++){
 n=n/10; 
 byte tetra= func/n;
 if (tetra>0)  k = 1;
 byte bukva=tetra+0x30; // переводим цифру в код
 if (k>0|| i==3) LcdCharacter(bukva);
 else LcdCharacter(0x20);// печатаем пустое место если впереди ноль
 func=func-tetra*n;}
}

void LcdWrite(byte dc, byte data){
 if (dc==1) PORTD |= 0b00010000;
 else PORTD &= ~0b00010000;
 PORTD &= ~0b00100000;
 PORTD |= 0b00001000;
 PORTD &= ~0b00001000;
   for (char i=0; i<8; i++) {
     if(data &(0b10000000>>i)) PORTD |= 0b00010000;
     else PORTD &= ~0b00010000;
  PORTD |= 0b00001000;
  PORTD &= ~0b00001000;}
  PORTD |= 0b00100000;      
}


unsigned int n=0;
byte data0=0; 
byte data1=0;
byte data2=0;
byte data3=0;
unsigned int Freguency=0;
unsigned int Delitel;
byte DelitelH ;
byte DelitelL ;
byte var =0; // режим, 0- прием, 1- спектр, 2- скан
int sval=0;
int RSSI = 0;// максимум АРУ
int spec =0;
int MAXi = 0;// i при макс АРУ


void setup()  
{ 
  pinMode(PIN_SCE, OUTPUT);
pinMode(PIN_RESET, OUTPUT);
pinMode(PIN_SDIN, OUTPUT);
pinMode(PIN_SCLK, OUTPUT);
digitalWrite(PIN_RESET, LOW);
digitalWrite(PIN_SCE, HIGH);
digitalWrite(PIN_SCLK, LOW);
digitalWrite(PIN_SDIN, LOW);

  pinMode(Bolche, INPUT);
  digitalWrite(Bolche, HIGH);
  pinMode(Menche, INPUT);
  digitalWrite(Menche, HIGH);
  pinMode(Vvod, INPUT);
  digitalWrite(Vvod, HIGH);
  pinMode(Regim, INPUT);
  digitalWrite(Regim, HIGH);
 
 
 DelitelL= EEPROM.read(0);
 DelitelH= EEPROM.read(1);
 Freguency= (DelitelH *32 + DelitelL)*2 +479;
 if (Freguency>6000 || Freguency<5500) Freguency=5645;
 
 //CS - to digital pin 10  (SS pin)
 // * SDI - to digital pin 11 (MOSI pin)
 //* CLK - to digital pin 13 (SCK pin)
 //pinMode (slaveSelectPin, OUTPUT);
  pinMode (SSP, OUTPUT);
   
LcdInitialise();
LcdClear();
//LcdWrite(LCD_C, 0xA7); // Inverted display
LcdWrite(LCD_C, 0xA6); // Normal display
lcd_contrast(contrast);  
  // initialize SPI:
  SPI.begin();
  SPI.setBitOrder(LSBFIRST);
  
  digitalWrite(SSP,LOW);
  SPI.transfer(0x10);
  SPI.transfer(0x01);
  SPI.transfer(0x00);
  SPI.transfer(0x00);
  digitalWrite(SSP,HIGH);
  
  prog_freg();
  for (int z = 0; z < 4; z++){
  lcd_set_pos_pix(0, z+2);
for (int index = 0; index < 96; index++)
  {LcdWrite(LCD_D, LOGO[z][index]);}}
delay(3000);

for (int u = 0; u < 96; u++){
 for (int z = 0; z < 4; z++){
  lcd_set_pos_pix(0, z+2);
for (int index = u; index < 96; index++)
  {LcdWrite(LCD_D, LOGO[z][index]);}}
delay(20); 
 }
  delay (1000);}
  
void loop()
{  
   
  lcd_set_pos_pix(65, 0);
   if (var==0)  LcdString("RCV");
   if (var==1)  LcdString("SPC");
   if (var==2)  LcdString("SCN");
   
   while (digitalRead(Regim)==LOW)
     {
       var=var+1;
      if (var>2) var=0 ;
      lcd_set_pos_pix(65, 0);
      if (var==0)  LcdString("RCV");
      if (var==1)  LcdString("SPC");
      if (var==2) 
         {LcdString("SCN");};
      delay (800);
     };

 
    
    switch (var) {
    case 0:
    sval=0; 
for ( byte i = 0; i < 10; i++){
      sval = sval + analogRead(Rssiin);
       delay (5);}
  
  if (Freguency <5500) Freguency=5999;
  if (Freguency >6000) Freguency=5501;  
  if (digitalRead(Bolche)==LOW or digitalRead(Menche)==LOW)
     { n=n+1;
   
  if (digitalRead(Bolche)==LOW and n<15) Freguency=Freguency+2;
  if (digitalRead(Bolche)==LOW and n>=15) Freguency=Freguency+10;
     
  if (digitalRead(Menche)==LOW and n<15 )  Freguency=Freguency-2;
  if (digitalRead(Menche)==LOW and n>=15 )  Freguency=Freguency-10;
  prog_freg();
} 
 
  else { n=0;}
  lcd_set_pos_pix(0, 0);
  LcdString("FREG: ");
  LcdString_f(Freguency);
  lcd_set_pos_pix(0, 1);
  LcdString("RSSI:       ");
  lcd_set_pos_pix(35, 1);
  if (sval>1400) {
    LcdString_f(((sval-1400)/4));
  
  byte L=(sval-1380)/20;
   if (L>95) L=95;
   for (byte x = 0; x < L; x ++) { 
        lcd_set_pos_pix(x , 4);
        LcdWrite(LCD_D, 0xff);}
   for (byte x = L; x < 96; x ++) { 
        lcd_set_pos_pix(x , 4);
        LcdWrite(LCD_D, 0x00);}
  }
  else {LcdString("   0");
   for (byte x = 0; x < 96; x ++) { 
        lcd_set_pos_pix(x , 4);
        LcdWrite(LCD_D, 0x00);}};
  
  if (digitalRead(Vvod)==LOW)  
   {EEPROM.write(0, DelitelL);
    EEPROM.write(1, DelitelH);
    delay(3000);};
  
  
  delay(200);
      break;
      
      
    case 1:
   
    for ( byte i = 0; i < 95; i++){
      Freguency = 5525+5*i;
      prog_freg();
      
      lcd_set_pos_pix(0, 0);
      LcdString("FREG: ");
      LcdString_f(Freguency);
      if (digitalRead(Bolche)==LOW) delay (500);
      delay (20);
      sval=0;
      for ( byte u = 0; u < 10; u++){
      sval = sval + analogRead(Rssiin);
      delay (5);};
      if (sval<1280) sval=1280 ;
      spec = 4+(sval-1280)/40;
      //spec =(sval-1200)/40;
       column=i;
       Lcd_drawColumn(1,spec);
       column=i+1;
       Lcd_drawColumn(1, 0);
       if (digitalRead(Regim)==LOW ){ 
    var=0;
    DelitelL= EEPROM.read(0);
    DelitelH= EEPROM.read(1);
    Freguency= (DelitelH *32 + DelitelL)*2 +479;
    prog_freg();
 
     for ( byte m = 0; m < 95; m++)
    {
      column=m;
      Lcd_drawColumn(1, 0);};
       goto prer ;  };};  
  
      prer:
      break;
      
      
      case 2:
      sval=0;
      RSSI=0;
     
      for ( byte i = 0; i < 249; i++){
      Freguency = 5501+2*i;
      prog_freg();
      
  
  lcd_set_pos_pix(0, 0);
  LcdString("FREG: ");
  LcdString_f(Freguency);
  
  lcd_set_pos_pix(0, 1);
  delay (50) ;
  LcdString("RSSI:       ");
  sval =analogRead(Rssiin);
  lcd_set_pos_pix(35, 1);
  LcdString_f(sval);
  
  if (sval > RSSI )
           { RSSI=sval;
             MAXi=i ; };
             
 }
   Freguency = 5501+2*MAXi;
   prog_freg();
   var=0;
   break;
  
  }
 }
 void prog_freg (void) {
  
 Delitel=(Freguency -479)/2 ;
      DelitelH=Delitel>>5 ;
      DelitelL=Delitel &0x1F;
      data0=DelitelL *32 +17 ;
      data1=DelitelH *16 + DelitelL /8;
      data2=DelitelH /16 ;
 
      digitalWrite(SSP,LOW);
      SPI.transfer(data0);
      SPI.transfer(data1);
      SPI.transfer(data2);
      SPI.transfer(data3);
      digitalWrite(SSP,HIGH);}
